## main/Kconfig.projbuild
```kconfig
menu "Esteira - M2"
    config M2_WIFI_SSID
        string "WiFi SSID"
        default ""
    config M2_WIFI_PASS
        string "WiFi senha (nao publicar sdkconfig com senha)"
        default ""
    choice M2_PROTOCOL
        prompt "Protocolo do experimento"
        default M2_UDP
        config M2_UDP
            bool "UDP"
        config M2_TCP
            bool "TCP"
    endchoice
    config M2_PORT
        int "Porta UDP ou TCP na ESP32"
        range 1024 65535
        default 5000
    config M2_SNTP_SERVER
        string "Servidor SNTP"
        default "a.st1.ntp.br"
    config M2_SNTP_INTERVAL_MS
        int "Intervalo de ressincronizacao SNTP (ms)"
        range 15000 3600000
        default 60000
    config M2_LED_GPIO
        int "LED de E-stop (-1 desabilita; conferir placa)"
        range -1 33
        default -1
endmenu
```

## sdkconfig.defaults
```kconfig
CONFIG_IDF_TARGET="esp32"
CONFIG_FREERTOS_UNICORE=y
CONFIG_FREERTOS_HZ=1000
CONFIG_FREERTOS_GENERATE_RUN_TIME_STATS=y
CONFIG_FREERTOS_USE_TRACE_FACILITY=y
CONFIG_FREERTOS_RUN_TIME_STATS_USING_ESP_TIMER=y
CONFIG_ESP_DEFAULT_CPU_FREQ_MHZ_240=y
CONFIG_ESP_MAIN_TASK_STACK_SIZE=6144
CONFIG_LWIP_SNTP_UPDATE_DELAY=60000
```
